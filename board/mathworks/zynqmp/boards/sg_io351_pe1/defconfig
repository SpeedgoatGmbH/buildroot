## board/mathworks/zynqmp/boards/sg_io351_pe1/defconfig
```kconfig
###########################################
# IO351 Options
###########################################
BR2_TARGET_UBOOT_BOARD_DEFCONFIG="xilinx_zynqmp_zcu106_revA"
#BR2_TARGET_UBOOT_BOARD_DEFCONFIG="uboot_dotconfig"
BR2_PACKAGE_XILINX_BOOTLOADER_UBOOT_TARGET_DIR="board/xilinx/zynqmp/zynqmp-zcu106-revA"
#to add some specific filesystem elements for the IO351
BR2_ROOTFS_OVERLAY="./board/mathworks/common/fs-overlay ./board/mathworks/zynqmp/fs-overlay ./board/mathworks/zynqmp/boards/sg_io351_pe1/fs-overlay"
CONFIG_USE_BOOTARGS=y
```

## board/mathworks/zynqmp/defconfig/linux.defconfig
```kconfig
###########################################
# Linux Options
###########################################
# BR2_LINUX_KERNEL_DEFCONFIG="mw_zynqmp"
BR2_LINUX_KERNEL_DEFCONFIG="xilinx_zynqmp"
# BR2_LINUX_KERNEL_CONFIG_FRAGMENT_FILES="board/mathworks/zynqmp/defconfig/sg_zynqmp_config"
```

## package/aravis/Config.in
```kconfig
config BR2_PACKAGE_ARAVIS
	bool "aravis"
	depends on BR2_PACKAGE_LIBXML2
	depends on BR2_PACKAGE_GSTREAMER1
	depends on BR2_PACKAGE_GSTREAMER1_MM
	depends on BR2_PACKAGE_GST1_PLUGINS_BASE
	depends on BR2_PACKAGE_AUDIT
	depends on BR2_PACKAGE_LIBUSB
	help
	  The Aravis Libary supports GiGE Vision Cameras.
	  https://github.com/AravisProject/aravis
```

## package/gstreamer1/gst-omx-xil/Config.in
```kconfig
config BR2_PACKAGE_GST_OMX_XIL
	bool "gst-omx"
	depends on BR2_PACKAGE_VCU_OMX_IL
	select BR2_PACKAGE_VCU_OMX_IL
	help
	  GStreamer plug-in to use OpenMAX API.

	  http://cgit.freedesktop.org/gstreamer/gst-omx

comment "gst-omx requires a OpenMAX implementation"
	depends on !BR2_PACKAGE_VCU_OMX_IL
```

## package/vcu-ctrl-sw/Config.in
```kconfig
config BR2_PACKAGE_ZCU_CTRL_SW
	bool "vcu-ctrl-sw"

	help
	  This is a Xilinx provided software stack and library for the MPSoC VCU.
	  https://github.com/Xilinx/vcu-ctrl-sw
```

## package/vcu-omx-il/Config.in
```kconfig
config BR2_PACKAGE_VCU_OMX_IL
	bool "vcu-omx-il"

	help
	  This is a Xilinx provided software stack and library for the MPSoC VCU.
	  https://github.com/Xilinx/vcu-omx-il
```
